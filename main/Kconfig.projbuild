## main/Kconfig.projbuild
```kconfig
menu "Configuração do Wifi Configuration"

    config ESP_WIFI_SSID
        string "WiFi SSID"
        default "ssid"
        help
            Nome da rede Wifi.

    config ESP_WIFI_PASSWORD
        string "Senha do Wifi"
        default "minha_senha"
        help
            Senha do WiFi (WPA or WPA2).

    config ESP_MAXIMUM_RETRY
        int "Número máximo de tentativas de conexão"
        default 5
        help
            Configure o valor máximo de tentativas de conexão.

    config ESP_MQTT_HOST
        string "Endereço do servidor MQTT"
        default "mqtt://mqtt.eclipseprojects.io"
        help
            Endereço do servidor MQTT.

    config ESP_MATRICULA
        string "Matrícula do usuário"
        default "123456789"
        help
            Matrícula do usuário.

    config ESP_TOUCH
        bool "Habilitar ou desabilitar o sensor de toque"
        default false
        help
            Habilitar ou desabilitar o sensor de toque.
endmenu
```
